## build/conf/bblayers.conf
```bitbake
# POKY_BBLAYERS_CONF_VERSION is increased each time build/conf/bblayers.conf
# changes incompatibly
POKY_BBLAYERS_CONF_VERSION = "2"

BBPATH = "${TOPDIR}"
BBFILES ?= ""

BBLAYERS ?= " \
  ${GITHUB_WORKSPACE}/poky/meta \
  ${GITHUB_WORKSPACE}/poky/meta-poky \
  ${GITHUB_WORKSPACE}/poky/meta-yocto-bsp \
  "
```
